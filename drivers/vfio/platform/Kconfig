## drivers/vfio/platform/Kconfig
```kconfig
# SPDX-License-Identifier: GPL-2.0-only
config VFIO_PLATFORM
	tristate "VFIO support for platform devices"
  <<<<<<< patch-1
	depends on ARM || ARM64 || COMPILE_TEST
  =======
	depends on VFIO && EVENTFD && (ARM || ARM64 || COMPILE_TEST)
  >>>>>>> revert-7-master
	select VFIO_VIRQFD
	help
	  Support for platform devices with VFIO. This is required to make
	  use of platform devices present on the system using the VFIO
	  framework.

	  If you don't know what to do here, say N.

if VFIO_PLATFORM
config VFIO_AMBA
	tristate "VFIO support for AMBA devices"
  <<<<<<< patch-1
	depends on ARM_AMBA || COMPILE_TEST
  =======
	depends on VFIO_PLATFORM && (ARM_AMBA || COMPILE_TEST)
  >>>>>>> revert-7-master
	help
	  Support for ARM AMBA devices with VFIO. This is required to make
	  use of ARM AMBA devices present on the system using the VFIO
	  framework.

	  If you don't know what to do here, say N.

source "drivers/vfio/platform/reset/Kconfig"
endif
```
